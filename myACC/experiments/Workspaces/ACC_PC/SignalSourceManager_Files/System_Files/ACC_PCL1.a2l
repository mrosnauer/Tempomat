ASAP2_VERSION 1 41
/begin PROJECT ACC_PC "Generated by ETAS from Project ACC_PC"
/begin HEADER "" VERSION "000" PROJECT_NO ASD /end HEADER
/begin MODULE ACC_PC "Generated by ETAS ASCET7 from Project: ACC_PC"
/begin IF_DATA E_TARGET
 /begin SOURCE "Task0" 3 /* period */ 10 QP_BLOB 1 /end SOURCE
 /begin TP_BLOB /* programm id */ 4152380041 /* target id */ 7 0 2 0 /end TP_BLOB
/end IF_DATA
/begin MOD_PAR "" VERSION "000" ADDR_EPK 0x0 EPK "" SUPPLIER "ETAS GmbH" CUSTOMER "xxx" CUSTOMER_NO "000" USER "xxx" PHONE_NO "000" ECU "PC" CPU_TYPE "PCx86" NO_OF_INTERFACES 1 /end MOD_PAR
/begin MOD_COMMON "Common definitions" BYTE_ORDER MSB_LAST ALIGNMENT_BYTE 1 ALIGNMENT_WORD 2 ALIGNMENT_LONG 4 ALIGNMENT_FLOAT32_IEEE 4 ALIGNMENT_FLOAT64_IEEE 8 /end MOD_COMMON
/begin CHARACTERISTIC myCar.myCar.myVehicle.AirFriction "" CURVE 0x435008 STANDARD_CURVE_R64R64 0.0 esdl_ident -1.7976931348623157E+308 1.7976931348623157E+308
 /begin AXIS_DESCR STD_AXIS NO_INPUT_QUANTITY esdl_ident 6 -1.7976931348623157E+308 1.7976931348623157E+308 /end AXIS_DESCR
/end CHARACTERISTIC
/begin CHARACTERISTIC myCar.myCar.myVehicle.BrakeMomentum "" CURVE 0x435070 STANDARD_CURVE_R64R64 0.0 esdl_ident -1.7976931348623157E+308 1.7976931348623157E+308
 /begin AXIS_DESCR STD_AXIS NO_INPUT_QUANTITY esdl_ident 6 -1.7976931348623157E+308 1.7976931348623157E+308 /end AXIS_DESCR
/end CHARACTERISTIC
/begin CHARACTERISTIC myCar.myCar.myVehicle.EngineMomentum "" MAP 0x4350D8 STANDARD_MAP_R64R64R64 0.0 esdl_ident -1.7976931348623157E+308 1.7976931348623157E+308
 /begin AXIS_DESCR STD_AXIS NO_INPUT_QUANTITY esdl_ident 6 -1.7976931348623157E+308 1.7976931348623157E+308 /end AXIS_DESCR
 /begin AXIS_DESCR STD_AXIS NO_INPUT_QUANTITY esdl_ident 6 -1.7976931348623157E+308 1.7976931348623157E+308 /end AXIS_DESCR
/end CHARACTERISTIC
/begin CHARACTERISTIC myCar.myCar.myVehicle.Landscape "" CURVE 0x435260 STANDARD_CURVE_R64R64 0.0 esdl_ident -1.7976931348623157E+308 1.7976931348623157E+308
 /begin AXIS_DESCR STD_AXIS NO_INPUT_QUANTITY esdl_ident 128 -1.7976931348623157E+308 1.7976931348623157E+308 /end AXIS_DESCR
/end CHARACTERISTIC
/begin CHARACTERISTIC myCar.myCar.myVehicle.TrackSize "" VALUE 0x435000 STANDARD_VALUE_R64 0.0 esdl_ident -1.7976931348623157E+308 1.7976931348623157E+308 /end CHARACTERISTIC
/begin CHARACTERISTIC myWork.myDriver.p "" VALUE 0x4540B4 STANDARD_VALUE_R32 0.0 esdl_ident -3.4028234663852886E+38 3.4028234663852886E+38 /end CHARACTERISTIC
/begin CHARACTERISTIC myWork.myDriver.speed_gain "" VALUE 0x4540BA STANDARD_VALUE_U8 0.0 esdl_ident 0 1 BIT_MASK 0x1 /end CHARACTERISTIC
/begin CHARACTERISTIC myWork.myDriver.speed_loss "" VALUE 0x4540BB STANDARD_VALUE_U8 0.0 esdl_ident 0 1 BIT_MASK 0x1 /end CHARACTERISTIC
/begin CHARACTERISTIC myWork.myDriver.accButtonDriver "" VALUE 0x4540B8 STANDARD_VALUE_U8 0.0 esdl_ident 0 1 BIT_MASK 0x1 /end CHARACTERISTIC
/begin CHARACTERISTIC myWork.myDriver.accButtonOffDriver "" VALUE 0x4540B9 STANDARD_VALUE_U8 0.0 esdl_ident 0 1 BIT_MASK 0x1 /end CHARACTERISTIC
/begin CHARACTERISTIC myWork.myDriver.b "" VALUE 0x4540B0 STANDARD_VALUE_R32 0.0 esdl_ident -3.4028234663852886E+38 3.4028234663852886E+38 /end CHARACTERISTIC
/begin MEASUREMENT myCar.myCar.myVehicle.brakebuff "" FLOAT64_IEEE esdl_ident 1 100.0 -1.7976931348623157E+308 1.7976931348623157E+308 ECU_ADDRESS 0x454040 /end MEASUREMENT
/begin MEASUREMENT myCar.myCar.myVehicle.cont "" FLOAT64_IEEE esdl_ident 1 100.0 -1.7976931348623157E+308 1.7976931348623157E+308 ECU_ADDRESS 0x454048 /end MEASUREMENT
/begin MEASUREMENT myCar.myCar.myVehicle.dh "" FLOAT64_IEEE esdl_ident 1 100.0 -1.7976931348623157E+308 1.7976931348623157E+308 ECU_ADDRESS 0x454050 /end MEASUREMENT
/begin MEASUREMENT myCar.myCar.myVehicle.ds "" FLOAT64_IEEE esdl_ident 1 100.0 -1.7976931348623157E+308 1.7976931348623157E+308 ECU_ADDRESS 0x454058 /end MEASUREMENT
/begin MEASUREMENT myCar.myCar.myVehicle.h "" FLOAT64_IEEE esdl_ident 1 100.0 -1.7976931348623157E+308 1.7976931348623157E+308 ECU_ADDRESS 0x454060 /end MEASUREMENT
/begin MEASUREMENT myCar.myCar.myVehicle.lastbrake "" FLOAT64_IEEE esdl_ident 1 100.0 -1.7976931348623157E+308 1.7976931348623157E+308 ECU_ADDRESS 0x454068 /end MEASUREMENT
/begin MEASUREMENT myCar.myCar.myVehicle.momentum "" FLOAT64_IEEE esdl_ident 1 100.0 -1.7976931348623157E+308 1.7976931348623157E+308 ECU_ADDRESS 0x454070 /end MEASUREMENT
/begin MEASUREMENT myCar.myCar.myVehicle.s "" FLOAT64_IEEE esdl_ident 1 100.0 -1.7976931348623157E+308 1.7976931348623157E+308 ECU_ADDRESS 0x454078 /end MEASUREMENT
/begin MEASUREMENT myCar.myCar.myVehicle.v "" FLOAT64_IEEE esdl_ident 1 100.0 -1.7976931348623157E+308 1.7976931348623157E+308 ECU_ADDRESS 0x454080 /end MEASUREMENT
/begin MEASUREMENT resources.CarMessages.v "" FLOAT32_IEEE esdl_ident 1 100.0 -3.4028234663852886E+38 3.4028234663852886E+38 ECU_ADDRESS 0x4540C0 /end MEASUREMENT
/begin MEASUREMENT resources.CarMessages.power "" FLOAT32_IEEE esdl_ident 1 100.0 -3.4028234663852886E+38 3.4028234663852886E+38 ECU_ADDRESS 0x4540C4 /end MEASUREMENT
/begin MEASUREMENT resources.CarMessages.brake "" FLOAT32_IEEE esdl_ident 1 100.0 -3.4028234663852886E+38 3.4028234663852886E+38 ECU_ADDRESS 0x4540C8 /end MEASUREMENT
/begin MEASUREMENT resources.CarMessages.accActive "" UBYTE esdl_ident 1 100.0 0 1 ECU_ADDRESS 0x4540BC BIT_MASK 0x1 /end MEASUREMENT
/begin MEASUREMENT resources.DriverMessages.powerDriver "" FLOAT32_IEEE esdl_ident 1 100.0 -3.4028234663852886E+38 3.4028234663852886E+38 ECU_ADDRESS 0x4540D0 /end MEASUREMENT
/begin MEASUREMENT resources.DriverMessages.brakeDriver "" FLOAT32_IEEE esdl_ident 1 100.0 -3.4028234663852886E+38 3.4028234663852886E+38 ECU_ADDRESS 0x4540D4 /end MEASUREMENT
/begin MEASUREMENT resources.DriverMessages.up "" UBYTE esdl_ident 1 100.0 0 1 ECU_ADDRESS 0x4540CC BIT_MASK 0x1 /end MEASUREMENT
/begin MEASUREMENT resources.DriverMessages.down "" UBYTE esdl_ident 1 100.0 0 1 ECU_ADDRESS 0x4540CD BIT_MASK 0x1 /end MEASUREMENT
/begin MEASUREMENT resources.DriverMessages.accButtonPressed "" UBYTE esdl_ident 1 100.0 0 1 ECU_ADDRESS 0x4540CE BIT_MASK 0x1 /end MEASUREMENT
/begin MEASUREMENT resources.DriverMessages.accButtonOffPressed "" UBYTE esdl_ident 1 100.0 0 1 ECU_ADDRESS 0x4540CF BIT_MASK 0x1 /end MEASUREMENT
/begin MEASUREMENT myWork.myACC.internalActive "" UBYTE esdl_ident 1 100.0 0 1 ECU_ADDRESS 0x4540A8 BIT_MASK 0x1 /end MEASUREMENT
/begin MEASUREMENT myWork.myACC.v "" FLOAT32_IEEE esdl_ident 1 100.0 -3.4028234663852886E+38 3.4028234663852886E+38 ECU_ADDRESS 0x4540A4 /end MEASUREMENT
/begin MEASUREMENT myWork.myACC.target_speed "" FLOAT32_IEEE esdl_ident 1 100.0 -3.4028234663852886E+38 3.4028234663852886E+38 ECU_ADDRESS 0x4540A0 /end MEASUREMENT
/begin MEASUREMENT myWork.myACC.incDecTargetSpeed_instance.target_speed "" FLOAT32_IEEE esdl_ident 1 100.0 -3.4028234663852886E+38 3.4028234663852886E+38 ECU_ADDRESS 0x4540AC /end MEASUREMENT
/begin COMPU_METHOD esdl_ident "" RAT_FUNC /* format */ "%12.4" /* unit */ "" /* coeffs */ COEFFS 0 1 0 0 0 1 /end COMPU_METHOD
/begin FUNCTION ACC_PC ""
 /begin SUB_FUNCTION myCar.myCar myWork.myDriver myWork.myACC resources.TimeTick /end SUB_FUNCTION
/end FUNCTION
/begin FUNCTION myCar.myCar "" /begin IN_MEASUREMENT resources.CarMessages.brake resources.CarMessages.power /end IN_MEASUREMENT /begin OUT_MEASUREMENT resources.CarMessages.v /end OUT_MEASUREMENT /begin SUB_FUNCTION myCar.myCar.myVehicle /end SUB_FUNCTION /end FUNCTION
/begin FUNCTION myCar.myCar.myVehicle ""
 /begin DEF_CHARACTERISTIC myCar.myCar.myVehicle.AirFriction myCar.myCar.myVehicle.BrakeMomentum myCar.myCar.myVehicle.EngineMomentum myCar.myCar.myVehicle.Landscape myCar.myCar.myVehicle.TrackSize /end DEF_CHARACTERISTIC
 /begin LOC_MEASUREMENT myCar.myCar.myVehicle.brakebuff myCar.myCar.myVehicle.cont myCar.myCar.myVehicle.dh myCar.myCar.myVehicle.ds myCar.myCar.myVehicle.h myCar.myCar.myVehicle.lastbrake myCar.myCar.myVehicle.momentum myCar.myCar.myVehicle.s myCar.myCar.myVehicle.v /end LOC_MEASUREMENT
/end FUNCTION
/begin FUNCTION myWork.myDriver ""
 /begin DEF_CHARACTERISTIC myWork.myDriver.p myWork.myDriver.speed_gain myWork.myDriver.speed_loss myWork.myDriver.accButtonDriver myWork.myDriver.accButtonOffDriver myWork.myDriver.b /end DEF_CHARACTERISTIC
 /begin OUT_MEASUREMENT resources.DriverMessages.accButtonOffPressed resources.DriverMessages.accButtonPressed resources.DriverMessages.brakeDriver resources.DriverMessages.down resources.DriverMessages.powerDriver resources.DriverMessages.up /end OUT_MEASUREMENT
/end FUNCTION
/begin FUNCTION myWork.myACC ""
 /begin IN_MEASUREMENT resources.CarMessages.v resources.DriverMessages.accButtonOffPressed resources.DriverMessages.accButtonPressed resources.DriverMessages.brakeDriver resources.DriverMessages.down resources.DriverMessages.powerDriver resources.DriverMessages.up /end IN_MEASUREMENT
 /begin OUT_MEASUREMENT resources.CarMessages.accActive resources.CarMessages.brake resources.CarMessages.power /end OUT_MEASUREMENT
 /begin LOC_MEASUREMENT myWork.myACC.internalActive myWork.myACC.target_speed myWork.myACC.v /end LOC_MEASUREMENT
 /begin SUB_FUNCTION myWork.myACC.deactivateOnBrake_instance myWork.myACC.accButtonLogic_instance myWork.myACC.incDecTargetSpeed_instance /end SUB_FUNCTION
/end FUNCTION
/begin FUNCTION myWork.myACC.deactivateOnBrake_instance "" /end FUNCTION
/begin FUNCTION myWork.myACC.accButtonLogic_instance "" /end FUNCTION
/begin FUNCTION myWork.myACC.incDecTargetSpeed_instance "" /begin LOC_MEASUREMENT myWork.myACC.incDecTargetSpeed_instance.target_speed /end LOC_MEASUREMENT /end FUNCTION
/begin FUNCTION resources.TimeTick "" /end FUNCTION
/begin RECORD_LAYOUT STANDARD_CURVE_R64R64 /* axis size */ NO_AXIS_PTS_X 1 UWORD /* axis */ AXIS_PTS_X 2 FLOAT64_IEEE INDEX_INCR DIRECT FNC_VALUES 3 FLOAT64_IEEE COLUMN_DIR DIRECT /end RECORD_LAYOUT
/begin RECORD_LAYOUT STANDARD_MAP_R64R64R64 /* x axis size */ NO_AXIS_PTS_X 1 UWORD /* y axis size */ NO_AXIS_PTS_Y 2 UWORD /* x axis */ AXIS_PTS_X 3 FLOAT64_IEEE INDEX_INCR DIRECT /* y axis */ AXIS_PTS_Y 4 FLOAT64_IEEE INDEX_INCR DIRECT FNC_VALUES 5 FLOAT64_IEEE COLUMN_DIR DIRECT /end RECORD_LAYOUT
/begin RECORD_LAYOUT STANDARD_VALUE_R64 FNC_VALUES 1 FLOAT64_IEEE COLUMN_DIR DIRECT /end RECORD_LAYOUT
/begin RECORD_LAYOUT STANDARD_VALUE_R32 FNC_VALUES 1 FLOAT32_IEEE COLUMN_DIR DIRECT /end RECORD_LAYOUT
/begin RECORD_LAYOUT STANDARD_VALUE_U8 FNC_VALUES 1 UBYTE COLUMN_DIR DIRECT /end RECORD_LAYOUT
/begin GROUP ACC_PC "" ROOT
 /begin SUB_GROUP myCar.myCar resources.CarMessages myWork.myDriver resources.DriverMessages myWork.myACC resources.TimeTick /end SUB_GROUP
/end GROUP
/begin GROUP myCar.myCar "" /begin SUB_GROUP myCar.myCar.myVehicle /end SUB_GROUP /end GROUP
/begin GROUP myCar.myCar.myVehicle ""
 /begin REF_CHARACTERISTIC myCar.myCar.myVehicle.AirFriction myCar.myCar.myVehicle.BrakeMomentum myCar.myCar.myVehicle.EngineMomentum myCar.myCar.myVehicle.Landscape myCar.myCar.myVehicle.TrackSize /end REF_CHARACTERISTIC
 /begin REF_MEASUREMENT myCar.myCar.myVehicle.brakebuff myCar.myCar.myVehicle.cont myCar.myCar.myVehicle.dh myCar.myCar.myVehicle.ds myCar.myCar.myVehicle.h myCar.myCar.myVehicle.lastbrake myCar.myCar.myVehicle.momentum myCar.myCar.myVehicle.s myCar.myCar.myVehicle.v /end REF_MEASUREMENT
/end GROUP
/begin GROUP resources.CarMessages ""
 /begin REF_MEASUREMENT resources.CarMessages.accActive resources.CarMessages.brake resources.CarMessages.power resources.CarMessages.v /end REF_MEASUREMENT
/end GROUP
/begin GROUP myWork.myDriver ""
 /begin REF_CHARACTERISTIC myWork.myDriver.p myWork.myDriver.speed_gain myWork.myDriver.speed_loss myWork.myDriver.accButtonDriver myWork.myDriver.accButtonOffDriver myWork.myDriver.b /end REF_CHARACTERISTIC
/end GROUP
/begin GROUP resources.DriverMessages ""
 /begin REF_MEASUREMENT resources.DriverMessages.accButtonOffPressed resources.DriverMessages.accButtonPressed resources.DriverMessages.brakeDriver resources.DriverMessages.down resources.DriverMessages.powerDriver resources.DriverMessages.up /end REF_MEASUREMENT
/end GROUP
/begin GROUP myWork.myACC ""
 /begin REF_MEASUREMENT myWork.myACC.internalActive myWork.myACC.target_speed myWork.myACC.v /end REF_MEASUREMENT
 /begin SUB_GROUP myWork.myACC.deactivateOnBrake_instance myWork.myACC.accButtonLogic_instance myWork.myACC.incDecTargetSpeed_instance /end SUB_GROUP
/end GROUP
/begin GROUP myWork.myACC.deactivateOnBrake_instance "" /end GROUP
/begin GROUP myWork.myACC.accButtonLogic_instance "" /end GROUP
/begin GROUP myWork.myACC.incDecTargetSpeed_instance "" /begin REF_MEASUREMENT myWork.myACC.incDecTargetSpeed_instance.target_speed /end REF_MEASUREMENT /end GROUP
/begin GROUP resources.TimeTick "" /end GROUP
/end MODULE
/end PROJECT
